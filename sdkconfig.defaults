## sdkconfig.defaults
```kconfig
# Arduino-ESP32 requires 1000 Hz tick (see framework-arduinoespressif32/CMakeLists.txt).
CONFIG_FREERTOS_HZ=1000

# New PlatformIO environments must bootstrap Arduino+IDF glue (defines app_main → setup/loop).
CONFIG_ENABLE_ARDUINO_DEPENDS=y
CONFIG_AUTOSTART_ARDUINO=y
CONFIG_ARDUINO_VARIANT="esp32"
```
